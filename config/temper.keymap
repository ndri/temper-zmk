/*
 * https://github.com/zmkfirmware/zmk/blob/main/app/include/dt-bindings/zmk/keys.h
 */

#include <behaviors.dtsi>
#include <dt-bindings/zmk/keys.h>
#include <dt-bindings/zmk/bt.h>
#include <locale/keys_et.h>

#include "zmk-helpers/helper.h"
#include "zmk-helpers/key-labels/36.h"

#define BASE 0
#define SYM1 1
#define SYM2 2
#define NAV 3
#define MISC 4

#define XXX &none
#define ___ &trans

#define KEYS_L LT0 LT1 LT2 LT3 LT4 LM0 LM1 LM2 LM3 LM4 LB0 LB1 LB2 LB3 LB4
#define KEYS_R RT0 RT1 RT2 RT3 RT4 RM0 RM1 RM2 RM3 RM4 RB0 RB1 RB2 RB3 RB4
#define THUMBS LH2 LH1 LH0 RH0 RH1 RH2

ZMK_HOLD_TAP(hml,
    flavor = "balanced";
    tapping-term-ms = <200>;
    quick-tap-ms = <150>;                // repeat on tap-into-hold
    require-prior-idle-ms = <100>;
    bindings = <&kp>, <&kp>;
    hold-trigger-key-positions = <KEYS_R THUMBS>;
    hold-trigger-on-release;             // delay positional check until key-release
)

/* right-hand HRMs */
ZMK_HOLD_TAP(hmr,
    flavor = "balanced";
    tapping-term-ms = <200>;
    quick-tap-ms = <150>;                // repeat on tap-into-hold
    require-prior-idle-ms = <100>;
    bindings = <&kp>, <&kp>;
    hold-trigger-key-positions = <KEYS_L THUMBS>;
    hold-trigger-on-release;             // delay positional check until key-release
)

#define HRML(k1, k2, k3, k4) &hml LCTRL k1 &hml LALT k2 &hml LSHIFT k3 &hml LGUI k4
#define HRMR(k1, k2, k3, k4) &hmr RGUI k1 &hmr RSHIFT k2 &hmr LALT k3 &hmr RCTRL k4

// ---------- SETTINGS ----------

// ----------- COMBOS -----------

// ----------- KEYMAP -----------

ZMK_LAYER(default_layer,
// --------------------------------------------------------------------------------------------------------------------
// |    Q    |    W    |    F    |    P    |    B    |              |    J    |    L    |    U    |    Y    |    Ü    |
// |    A    |    R    |    S    |    T    |    G    |              |    M    |    N    |    E    |    I    |    O    |
// |    Z    |    X    |    C    |    D    |    V    |              |    K    |    H    |    Õ    |    Ä    |    Ö    |
//                     |   ESC   |  SPACE  |   TAB   |              |  ENTER  |  BCKSP  |   DEL   |
    &kp Q     &kp W     &kp F        &kp P     &kp B                 &kp J         &kp L    &kp U          &kp Y           &kp ET_U_UMLAUT
   HRML(A,        R,        S,           T)    &kp G                 &kp M        HRMR(N,       E,             I,              O)
    &kp Z     &kp X     &kp C        &kp D     &kp V                 &kp K         &kp H    &kp ET_O_TILDE &kp ET_A_UMLAUT &kp ET_O_UMLAUT
                        &lt SYM1 ESC &kp SPACE &lt MISC TAB          &lt NAV ENTER &kp BSPC &lt SYM2 DEL
)

ZMK_LAYER(symbols1_layer,
// --------------------------------------------------------------------------------------------------------------------
// |    1    |    2    |    3    |    4    |    5    |              |    6    |    7    |    8    |    9    |    0    |
// |    /    |    *    |    |    |    ^    |    \    |              |    ?    |    !    |    ,    |    .    |    -    |
// |    %    |    #    |    &    |    @    |    ~    |              |    +    |    =    |    ;    |    :    |    _    |
//                     |         |  SPACE  |   TAB   |              |  ENTER  |  BCKSP  |   DEL   |
    &kp N1    &kp N2   &kp N3        &kp N4        &kp N5           &kp N6        &kp N7       &kp N8       &kp N9       &kp N0
   HRML(ET_FSLH,  ET_STAR, LA(ET_TILDE), ET_CARET) &kp ET_BSLH      &kp ET_QMARK HRMR(EXCL,        COMMA,       DOT,         ET_MINUS)
    &kp PRCNT &kp HASH &kp ET_AMPS   &kp ET_AT     &kp ET_GT        &kp ET_PLUS   &kp ET_EQUAL &kp ET_SEMI  &kp ET_COLON &kp ET_UNDER
                       &kp ___       &kp SPACE     &kp ENTER        &kp ENTER     &kp BSPC     &kp DEL
)

ZMK_LAYER(symbols2_layer,
// --------------------------------------------------------------------------------------------------------------------
// |         |         |         |         |         |              |         |         |         |         |         |
// |    (    |    )    |    [    |    ]    |    $    |              |         |         |         |         |         |
// |    <    |    >    |    {    |    }    |    €    |              |         |         |    '    |    "    |    `    |
//                     |   ESC   |  SPACE  |   TAB   |              |  ENTER  |  BCKSP  |         |
    &kp ___      &kp ___      &kp ___     &kp ___      &kp ___         &kp ___   &kp ___  &kp ___    &kp ___    &kp ___
   HRML(ET_LPAR,     ET_RPAR,     ET_LBKT,    ET_RBKT) &kp ET_DLLR     &kp ___  HRMR(___,     ___,       ___,       ___)
    &kp ET_CARON &kp ET_TILDE &kp ET_LBRC &kp ET_RBRC  &kp ET_CURREN   &kp ___   &kp ___  &kp ET_SQT &kp ET_DQT &kp LA(ET_ACUTE)
                              &kp ESC     &kp SPACE    &kp TAB         &kp ENTER &kp BSPC &kp ___
)

ZMK_LAYER(nav_layer,
// --------------------------------------------------------------------------------------------------------------------
// |   F1    |   F2    |   F3    |   F4    |         |              |         |  Cmd+←  | Page dn | Page up |  Cmd+→  |
// |   F5    |   F6    |   F7    |   F8    |         |              |         |    ←    |    ↓    |    ↑    |    →    |
// |   F9    |   F10   |  F11    |  F12    |         |              |         |   Home  |  Ctrl+← |  Ctrl+→ |   End   |
//                     |   ESC   |  SPACE  |   TAB   |              |         |  BCKSP  |   DEL   |
   &kp F1    &kp F2    &kp F3    &kp F4     &kp ___                 &bt BT_CLR &kp LG(LEFT) &kp PG_DN    &kp PG_UP     &kp LG(RIGHT)
  HRML(F5,       F6,       F7,       F8)    &kp ___                 &kp ___    &kp LEFT     &kp DOWN     &kp UP        &kp RIGHT
   &kp F9    &kp F10   &kp F11   &kp F12    &kp ___                 &kp ___    &kp HOME     &kp LC(LEFT) &kp LC(RIGHT) &kp END
                       &kp ESC   &kp SPACE  &kp TAB                 &kp ___    &kp BSPC     &kp DEL
)

ZMK_LAYER(misc_layer,
// --------------------------------------------------------------------------------------------------------------------
// |  Reset  |   Stop  |   Prev  |   Next  |  Reset  |              |  Reset  |         |         |         |  Reset  |
// |   Play  | VolMute | VolDown |  VolUp  |  Redo2  |              |         |         |         |         |         |
// |   Undo  |   Cut   |  Paste  |   Copy  |  Redo1  |              |         |         |         |         |         |
//                     |   DEL   |  BCKSP  |         |              |         |         |         |
    &kp &bootloader &kp C_STOP &kp C_PREV   &kp C_NEXT   &bt BT_CLR           &kp &sys_reset &kp ___ &kp ___ &kp ___ &kp &bootloader
    &kp C_PLAY      &kp C_MUTE &kp C_VOL_DN &kp C_VOL_UP &kp LG(Y)            &kp ___        &kp ___ &kp ___ &kp ___ &kp ___
    &kp LG(Z)       &kp LG(X)  &kp LG(V)    &kp LG(C)    &kp LG(LS(Z))        &kp ___        &kp ___ &kp ___ &kp ___ &kp ___
                               &kp DEL      &kp BSPC     &kp ___              &kp ___        &kp ___ &kp ___
)

ZMK_LAYER(test_layer,
    &kp ET_LBRC &kp ET_PIPE &kp ET_RBRC  &kp ET_TILDE &kp ET_POUND_SIGN   &kp ET_CURREN &kp ET_SECT &kp ET_ACUTE &kp ET_FRAC_1_2 &kp ET_CARON
    &kp ET_EURO &kp ET_DQT  &kp ET_HASH  &kp ET_DLLR  &kp ET_PRCNT        &kp ET_SQT    &kp ET_LPAR &kp ET_RPAR  &kp ET_LT       &kp ET_GT
    &kp ET_LBKT &kp ET_RBKT &kp ET_GRAVE &kp ET_TILDE &kp TILDE           &kp TILDE2    &kp NUHS    &kp KP_PLUS  &kp KP_MINUS    &kp KP_EQUAL
                            &kp ___      &kp ___      &kp ___             &kp ___       &kp ___     &kp ___
)

// ZMK_LAYER(new_layer,
// // --------------------------------------------------------------------------------------------------------------------
// // |         |         |         |         |         |              |         |         |         |         |         |
// // |         |         |         |         |         |              |         |         |         |         |         |
// // |         |         |         |         |         |              |         |         |         |         |         |
// //                     |         |         |         |              |         |         |         |
//     &kp ___ &kp ___ &kp ___ &kp ___ &kp ___                           &kp ___ &kp ___ &kp ___ &kp ___ &kp ___
//     &kp ___ &kp ___ &kp ___ &kp ___ &kp ___                           &kp ___ &kp ___ &kp ___ &kp ___ &kp ___
//     &kp ___ &kp ___ &kp ___ &kp ___ &kp ___                           &kp ___ &kp ___ &kp ___ &kp ___ &kp ___
//                     &kp ___ &kp ___ &kp ___                           &kp ___ &kp ___ &kp ___
// )
